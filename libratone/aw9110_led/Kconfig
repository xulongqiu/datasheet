## libratone/aw9110_led/Kconfig
```kconfig
config AW9110_I2C
    bool "AW9110_I2C support"
    depends on I2C 
    default y
    help
      If you say yes here you get support for AW9110 I2C support
config AW9110_I2C_EXT_GPIO
    bool "AW9110_I2C support"
    depends on I2C 
    default y
    help
      If you say yes here you get support for AW9110 I2C support
```

## libratone/aw9120/Kconfig
```kconfig
config AW9120_I2C
    bool "AW9120_I2C support"
    depends on I2C 
    default y
    help
      If you say yes here you get support for AW9110 I2C support
```

## libratone/typecusb/Kconfig
```kconfig
config USB_FUSB302
    bool "USB_FUSB302 support"
    depends on I2C 
    default y
    help
      If you say yes here you get support for typeC contorller FUSB302 support
```
